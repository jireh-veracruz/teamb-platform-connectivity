## project/stm32mp1xx/ca7/meta-connectivity/conf/layer.conf
```bitbake
# conf/layer.conf — meta-connectivity
BBPATH .= ":${LAYERDIR}"
LCONF_VERSION = "7"

# Register this layer as a collection named "connectivity"
BBFILE_COLLECTIONS += "connectivity"

# Pattern telling BitBake where to find recipes in this layer
# (Use LAYERDIR so it works regardless of absolute path)
BBFILE_PATTERN_connectivity := "^${LAYERDIR}/"

# Priority (higher number wins in conflicts; 6–9 is typical)
BBFILE_PRIORITY_connectivity = "7"

# Layer compatibility with your Yocto/OE series.
# OpenSTLinux releases for STM32MP15 are commonly based on Kirkstone.
LAYERSERIES_COMPAT_connectivity = "kirkstone"

# Optional but fine to keep:
BBFILES += "${LAYERDIR}/recipes-*/*/*.bb"
```
